## configs/ichigo_v1_defconfig
```kconfig
CONFIG_ARCH_ZYNQ=y
CONFIG_ARM_DCC=y
CONFIG_ARM=y
CONFIG_BOOT_SCRIPT_OFFSET=0x80000
CONFIG_CFI_FLASH=y
CONFIG_CI_UDC=y
CONFIG_CLOCKS=y
CONFIG_CMD_DFU=y
CONFIG_CMD_GPIO=y
CONFIG_CMD_I2C=y
CONFIG_CMD_IMLS=y
CONFIG_CMD_MEMTEST=y
CONFIG_CMD_MMC=y
CONFIG_CMD_MTDPARTS_SPREAD=y
CONFIG_CMD_MTDPARTS=y
CONFIG_CMD_MTD=y
CONFIG_CMD_NAND_LOCK_UNLOCK=y
CONFIG_CMD_SF_TEST=y
CONFIG_CMD_TIMER=y
CONFIG_CMD_TIME=y
CONFIG_CMD_USB=y
CONFIG_DEFAULT_DEVICE_TREE="zynq-ichigo-v1"
CONFIG_DFU_SF=y
CONFIG_DFU_TIMEOUT=y
CONFIG_DISTRO_DEFAULTS=y
CONFIG_DM_GPIO=y
CONFIG_DM_I2C=y
CONFIG_ENV_IS_IN_SPI_FLASH=y
CONFIG_ENV_IS_NOWHERE=y
CONFIG_ENV_OFFSET=0x40000
CONFIG_ENV_OFFSET_REDUND=0x60000
CONFIG_FIT=y
CONFIG_FLASH_SHOW_PROGRESS=10
CONFIG_FPGA_XILINX=y
CONFIG_FPGA_ZYNQPL=y
CONFIG_I2C_EEPROM=y
CONFIG_LED_GPIO=y
CONFIG_LED=y
CONFIG_LEGACY_IMAGE_FORMAT=y
CONFIG_MISC=y
CONFIG_MMC_SDHCI=y
CONFIG_MMC_SDHCI_ZYNQ=y
CONFIG_MTD_NOR_FLASH=y
CONFIG_MTD_RAW_NAND=y
CONFIG_MTD=y
CONFIG_NAND_ZYNQ=y
CONFIG_OF_BOARD=y
CONFIG_REMAKE_ELF=y
CONFIG_SF_DEFAULT_SPEED=50000000
CONFIG_SPI_FLASH_WINBOND=y
CONFIG_SPL_BSS_MAX_SIZE=0x100000
CONFIG_SPL_BSS_START_ADDR=0x100000
CONFIG_SPL_DM_SEQ_ALIAS=y
CONFIG_SPL_HAS_BSS_LINKER_SECTION=y
CONFIG_SPL_LOAD_FIT_ADDRESS=0x10000000
CONFIG_SPL_LOAD_FIT=y
CONFIG_SPL_MAX_SIZE=0x30000
CONFIG_SPL_SPI_LOAD=y
CONFIG_SPL_STACK=0xfffffe00
CONFIG_SPL_STACK_R_ADDR=0x200000
CONFIG_SPL_STACK_R=y
CONFIG_SPL_SYS_DCACHE_OFF=y
CONFIG_SPL=y
CONFIG_SYS_ALT_MEMTEST=y
CONFIG_SYS_BOOTM_LEN=0x3c00000
CONFIG_SYS_CONFIG_NAME="ichigo_v1"
CONFIG_SYS_CUSTOM_LDSCRIPT=y
CONFIG_SYS_DEVICE_NULLDEV=y
CONFIG_SYS_DFU_DATA_BUF_SIZE=0x600000
CONFIG_SYS_FLASH_CFI=y
CONFIG_SYS_FLASH_QUIET_TEST=y
CONFIG_SYS_FLASH_USE_BUFFER_WRITE=y
CONFIG_SYS_I2C_CADENCE=y
CONFIG_SYS_L2CACHE_OFF=y
CONFIG_SYS_LDSCRIPT="arch/arm/mach-zynq/u-boot.lds"
CONFIG_SYS_LOAD_ADDR=0x0
CONFIG_SYS_MAXARGS=32
CONFIG_SYS_MEMTEST_END=0x00001000
CONFIG_SYS_MEMTEST_START=0x00000000
CONFIG_SYS_PBSIZE=2071
CONFIG_SYS_PROMPT="Ichigo v1> "
CONFIG_SYS_REDUNDAND_ENVIRONMENT=y
CONFIG_SYS_SPI_U_BOOT_OFFS=0x100000
CONFIG_SYS_SPL_ARGS_ADDR=0x10000000
CONFIG_SYS_SPL_MALLOC_SIZE=0x2000000
CONFIG_SYS_SPL_MALLOC=y
CONFIG_SYS_TIMER_COUNTS_DOWN=y
CONFIG_TEXT_BASE=0x4000000
CONFIG_USB_EHCI_HCD=y
CONFIG_USB_GADGET_DOWNLOAD=y
CONFIG_USB_GADGET_MANUFACTURER="Xilinx"
CONFIG_USB_GADGET_PRODUCT_NUM=0x0300
CONFIG_USB_GADGET_VENDOR_NUM=0x03fd
CONFIG_USB_GADGET=y
CONFIG_USB_ULPI_VIEWPORT=y
CONFIG_USB_ULPI=y
CONFIG_USB=y
CONFIG_USE_PREBOOT=y
CONFIG_ZYNQ_QSPI=y
CONFIG_ZYNQ_SERIAL=y
CONFIG_ZYNQ_SPI=y
```
